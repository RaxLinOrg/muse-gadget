## esp32/components/muse_clock/Kconfig
```kconfig
menu "Muse clock page"

config MUSE_CLOCK_ENABLED
    bool "Clock and weather page"
    default y
    help
        Adds a swipe page between the character and settings showing the
        time, the date and a three-day forecast. Turning this off leaves the
        page out of the tileview entirely, so settings stays one swipe from
        the character.

config MUSE_CLOCK_LATITUDE
    string "Custom city: latitude"
    default "37.3382"
    depends on MUSE_CLOCK_ENABLED
    help
        Decimal degrees, north positive. This is the last entry in the city
        list on the settings page, for somewhere that is not already on it.
        The cities themselves live in muse_clock_cities.h; the one the page
        starts on is the first in that table.

config MUSE_CLOCK_LONGITUDE
    string "Custom city: longitude"
    default "-121.8863"
    depends on MUSE_CLOCK_ENABLED
    help
        Decimal degrees, east positive.

config MUSE_CLOCK_PLACE
    string "Custom city: name"
    default "Custom"
    depends on MUSE_CLOCK_ENABLED
    help
        What the custom entry is called, in the city list and along the
        bottom of the page. Cosmetic: nothing is looked up from it.

config MUSE_CLOCK_FAHRENHEIT
    bool "Fahrenheit"
    default n
    depends on MUSE_CLOCK_ENABLED
    help
        Ask Open-Meteo for Fahrenheit instead of Celsius.

config MUSE_CLOCK_24H
    bool "24-hour clock"
    default y
    depends on MUSE_CLOCK_ENABLED
    help
        Off shows a 12-hour time with AM or PM beside it.

config MUSE_CLOCK_NTP_SERVER
    string "NTP server"
    default "pool.ntp.org"
    depends on MUSE_CLOCK_ENABLED
    help
        Where the time comes from, once Wi-Fi is up.

endmenu
```

## esp32/components/muse_radio/Kconfig
```kconfig
menu "Muse radio page"

config MUSE_RADIO_ENABLED
    bool "Internet radio page"
    default y
    help
        Adds a swipe page listing a handful of internet radio stations and
        plays the one you tap through the speaker. Turning this off leaves
        the page out of the tileview entirely, so settings stays one swipe
        closer to the character.

        The station list is compiled in (muse_radio.c), and every URL in it
        must be plain MP3 over HTTPS: there is no AAC or Ogg decoder on the
        board, and the page refuses a stream whose Content-Type is neither.

endmenu
```
